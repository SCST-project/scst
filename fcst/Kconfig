## iscsi-scst/kernel/Kconfig
```kconfig
config SCST_ISCSI
	tristate "ISCSI Target"
	depends on SCST && INET && LIBCRC32C
	default SCST
	help
	  ISCSI target driver for SCST framework. The iSCSI protocol has been
	  defined in RFC 3720. To use it you should download from
	  http://scst.sourceforge.net the user space part of it.

config SCST_ISCSI_DEBUG_DIGEST_FAILURES
	bool "Simulate iSCSI digest failures"
	depends on SCST_ISCSI
	help
	  Simulates iSCSI digest failures in random places. Even when iSCSI
	  traffic is sent over a TCP connection, the 16-bit TCP checksum is too
	  weak for the requirements of a storage protocol. Furthermore, there
	  are also instances where the TCP checksum does not protect iSCSI
	  data, as when data is corrupted while being transferred on a PCI bus
	  or while in memory. The iSCSI protocol therefore defines a 32-bit CRC
	  digest on iSCSI packets in order to detect data corruption on an
	  end-to-end basis. CRCs can be used on iSCSI PDU headers and/or data.
	  Enabling this option allows to test digest failure recovery in the
	  iSCSI initiator that is talking to SCST.

	  If unsure, say "N".
```

## iscsi-scst/kernel/isert-scst/Kconfig
```kconfig
config SCST_ISER
	tristate "iSER Target Driver"
	depends on SCST && SCST_ISCSI && INFINIBAND
	default SCST
	help
	  ISER target driver for SCST framework. iSER is a protocol that
	  extends iSCSI to use Remote Direct Memory Access (RDMA). RDMA over
	  InfiniBand, iWARP and RoCE are supported. The iSCSI iSER extension
	  has been defined in RFC 5046.

	  If unsure, say "N".
```

## mpt/in-tree/Kconfig
```kconfig
config FUSION_SCST
	tristate "Fusion MPT SCST driver"
	depends on FUSION
	---help---
	  This module enables target mode for use by the SCST middle
	  level drivers.  You will also need the SCST middle level
	  drivers from http://scst.sourceforge.net/.

	  If unsure whether you really want or need this, say N.
```

## qla2x00t-32gbit/Kconfig
```kconfig
# SPDX-License-Identifier: GPL-2.0-only
config SCSI_QLA_FC
	tristate "QLogic QLA2XXX Fibre Channel Support"
	depends on PCI && SCSI
	depends on SCSI_FC_ATTRS
	depends on NVME_FC || !NVME_FC
	select FW_LOADER
	select BTREE
	help
	  This qla2xxx driver supports all QLogic Fibre Channel
	  PCI and PCIe host adapters.

	  By default, firmware for the ISP parts will be loaded
	  via the Firmware Loader interface.

	  ISP               Firmware Filename
	  ----------        -----------------
	  21xx              ql2100_fw.bin
	  22xx              ql2200_fw.bin
	  2300, 2312, 6312  ql2300_fw.bin
	  2322, 6322        ql2322_fw.bin
	  24xx, 54xx        ql2400_fw.bin
	  25xx              ql2500_fw.bin

	  Upon request, the driver caches the firmware image until
	  the driver is unloaded.

	  Firmware images can be retrieved from:

	        http://ldriver.qlogic.com/firmware/

	  They are also included in the linux-firmware tree as well.

config SCSI_QLA2XXX_TARGET
	bool "QLogic 2xxx target mode support"
	depends on SCSI_QLA_FC
	default y
	help
	  This option enables target mode hooks used by the SCST qla2x00t
	  driver. Once qla2x00tgt module is loaded, target mode for each
	  port can be enable via sysfs interface.

	  You will also need the SCST middle level for qla2x00t.

config SCST_QLA_TGT_ADDON
	tristate "QLogic SCST Target Driver"
	depends on SCSI_QLA2XXX_TARGET
	default y
	help
	  SCST QLogic 32 gbit/s target driver.
```

## qla2x00t/Kconfig
```kconfig
config SCSI_QLA_FC
	tristate "QLogic QLA2XXX Fibre Channel Support"
	depends on PCI && SCSI
	select SCSI_FC_ATTRS
	select FW_LOADER
	help
	  This qla2xxx driver supports all QLogic Fibre Channel
	  PCI and PCIe host adapters.

	  By default, firmware for the ISP parts will be loaded
	  via the Firmware Loader interface.

	  ISP               Firmware Filename
	  ----------        -----------------
	  21xx              ql2100_fw.bin
	  22xx              ql2200_fw.bin
	  2300, 2312, 6312  ql2300_fw.bin
	  2322, 6322        ql2322_fw.bin
	  24xx, 54xx        ql2400_fw.bin
	  25xx              ql2500_fw.bin

	  Upon request, the driver caches the firmware image until
	  the driver is unloaded.

	  Firmware images can be retrieved from:

	        http://ldriver.qlogic.com/firmware/

config SCSI_QLA2XXX_TARGET
	bool "QLogic 2xxx target mode support"
	depends on SCSI_QLA_FC
	default y
	help
	  This option enables target mode hooks used by the SCST qla2x00t
	  driver. Once qla2x00tgt module is loaded, target mode for each
	  port can be enable via sysfs interface.

	  You will also need the SCST middle level for qla2x00t.

config SCST_QLA_TGT_ADDON
	tristate "QLogic 2XXX Target Mode Add-On"
	depends on SCST && SCSI_QLA_FC && SCSI_QLA2XXX_TARGET
	default SCST
	help
	  Target mode add-on driver for QLogic 2xxx Fibre Channel host adapters.
	  Visit http://scst.sourceforge.net for more info about this driver.

config QLA_TGT_DEBUG_WORK_IN_THREAD
	bool "Use threads context only"
	depends on SCST_QLA_TGT_ADDON
	help
	  Makes SCST process incoming commands from the qla2x00t target
	  driver and call the driver's callbacks in internal SCST
	  threads context instead of SIRQ context, where thise commands
	  were received. Useful for debugging and lead to some
	  performance loss.

	  If unsure, say "N".

config QLA_TGT_DEBUG_SRR
	bool "SRR debugging"
	depends on SCST_QLA_TGT_ADDON
	help
	  Turns on retransmitting packets (SRR)
	  debugging. In this mode some CTIOs will be "broken" to force the
	  initiator to issue a retransmit request. Useful for debugging and lead to big
	  performance loss.

	  If unsure, say "N".
```

## qla2x00t/qla2x00-target/Kconfig
```kconfig
config SCST_QLA_TGT_ADDON
	tristate "QLogic 2XXX Target Mode Add-On"
	depends on SCST && SCSI_QLA_FC && SCSI_QLA2XXX_TARGET
	default SCST
	help
	  Target mode add-on driver for QLogic 2xxx Fibre Channel host adapters.
	  Visit http://scst.sourceforge.net for more info about this driver.

config QLA_TGT_DEBUG_WORK_IN_THREAD
	bool "Use threads context only"
	depends on SCST_QLA_TGT_ADDON
	help
	  Makes SCST process incoming commands from the qla2x00t target
	  driver and call the driver's callbacks in internal SCST
	  threads context instead of SIRQ context, where thise commands
	  were received. Useful for debugging and lead to some
	  performance loss.

	  If unsure, say "N".

config QLA_TGT_DEBUG_SRR
	bool "SRR debugging"
	depends on SCST_QLA_TGT_ADDON
	help
	  Turns on retransmitting packets (SRR)
	  debugging. In this mode some CTIOs will be "broken" to force the
	  initiator to issue a retransmit request. Useful for debugging and lead to big
	  performance loss.

	  If unsure, say "N".
```

## scst/kernel/in-tree/Kconfig.drivers.Linux-2.6.18.patch
```kconfig
diff -uprN ../orig/linux-2.6.24/drivers/Kconfig linux-2.6.24/drivers/Kconfig
--- ../orig/linux-2.6.24/drivers/Kconfig        2008-01-24 23:58:37.000000000 +0100
+++ linux-2.6.24/drivers/Kconfig        2008-05-13 13:05:55.000000000 +0200
@@ -18,6 +18,8 @@

 source "drivers/scsi/Kconfig"

+source "drivers/scst/Kconfig"
+
 source "drivers/cdrom/Kconfig"

 source "drivers/md/Kconfig"
```

## scst/kernel/in-tree/Kconfig.drivers.Linux-2.6.31.patch
```kconfig
diff -upkr -X linux-2.6.30/Documentation/dontdiff linux-2.6.30/drivers/Kconfig linux-2.6.30/drivers/Kconfig
--- linux-2.6.30/drivers/Kconfig	2008-07-14 01:51:29.000000000 +0400
+++ linux-2.6.30/drivers/Kconfig	2008-07-24 14:14:46.000000000 +0400
@@ -24,6 +24,8 @@ source "drivers/ide/Kconfig"
 
 source "drivers/scsi/Kconfig"
 
+source "drivers/scst/Kconfig"
+
 source "drivers/ata/Kconfig"
 
 source "drivers/md/Kconfig"
```

## scst/kernel/in-tree/Kconfig.drivers.Linux-2.6.35.patch
```kconfig
diff -upkr -X linux-2.6.35/Documentation/dontdiff linux-2.6.35/drivers/Kconfig linux-2.6.35/drivers/Kconfig
--- linux-2.6.35/drivers/Kconfig	2008-07-14 01:51:29.000000000 +0400
+++ linux-2.6.35/drivers/Kconfig	2008-07-24 14:14:46.000000000 +0400
@@ -22,6 +22,8 @@ source "drivers/ide/Kconfig"
 
 source "drivers/scsi/Kconfig"
 
+source "drivers/scst/Kconfig"
+
 source "drivers/ata/Kconfig"
 
 source "drivers/md/Kconfig"
```

## scst/kernel/in-tree/Kconfig.drivers.Linux-3.3.patch
```kconfig
diff --git a/drivers/Kconfig b/drivers/Kconfig
index a2b902f..92e3d67 100644
--- a/drivers/Kconfig
+++ b/drivers/Kconfig
@@ -22,6 +22,8 @@ source "drivers/ide/Kconfig"
 
 source "drivers/scsi/Kconfig"
 
+source "drivers/scst/Kconfig"
+
 source "drivers/ata/Kconfig"
 
 source "drivers/md/Kconfig"
```

## scst/kernel/in-tree/Kconfig.drivers.Linux-4.5.patch
```kconfig
diff --git a/drivers/Kconfig b/drivers/Kconfig
index c70d6e4..0a4ed1b 100644
--- a/drivers/Kconfig
+++ b/drivers/Kconfig
@@ -26,6 +26,8 @@ source "drivers/ide/Kconfig"
 
 source "drivers/scsi/Kconfig"
 
+source "drivers/scst/Kconfig"
+
 source "drivers/ata/Kconfig"
 
 source "drivers/md/Kconfig"
```

## scst/kernel/in-tree/Kconfig.drivers.Linux-4.8.patch
```kconfig
diff --git a/drivers/Kconfig b/drivers/Kconfig
index e1e2066cecdb..e7dd3af2a865 100644
--- a/drivers/Kconfig
+++ b/drivers/Kconfig
@@ -28,6 +28,8 @@ source "drivers/ide/Kconfig"
 
 source "drivers/scsi/Kconfig"
 
+source "drivers/scst/Kconfig"
+
 source "drivers/ata/Kconfig"
 
 source "drivers/md/Kconfig"
```

## scst/kernel/in-tree/Kconfig.drivers.Linux.patch
```kconfig
diff --git a/drivers/Kconfig b/drivers/Kconfig
index 8bad63417a50..a61b1804fcf3 100644
--- a/drivers/Kconfig
+++ b/drivers/Kconfig
@@ -39,6 +39,8 @@ source "drivers/ata/Kconfig"
 
 source "drivers/md/Kconfig"
 
+source "drivers/scst/Kconfig"
+
 source "drivers/target/Kconfig"
 
 source "drivers/message/fusion/Kconfig"
```

## scst/kernel/in-tree/Kconfig.scsi.Linux-2.6.24.patch
```kconfig
--- orig/linux-2.6.24/drivers/scsi/Kconfig	2008-01-24 23:58:37.000000000 +0100
+++ linux-2.6.24/drivers/scsi/Kconfig	2008-05-09 13:25:39.000000000 +0200
@@ -1351,6 +1351,8 @@ config SCSI_QLOGICPTI
 source "drivers/scsi/qla2xxx/Kconfig"
 source "drivers/scsi/qla4xxx/Kconfig"
 
+source "drivers/scsi/scsi_tgt/Kconfig"
+
 config SCSI_LPFC
 	tristate "Emulex LightPulse Fibre Channel Support"
 	depends on PCI && SCSI
```

## scst/kernel/in-tree/Kconfig.scsi.Linux-2.6.7.patch
```kconfig
--- Kconfig	2004-08-18 13:14:50.328907320 +0400
+++ Kconfig.scsi	2004-08-13 18:01:13.000000000 +0400
@@ -1261,6 +1261,8 @@ config SCSI_QLOGICPTI
 
 source "drivers/scsi/qla2xxx/Kconfig"
 
+source "drivers/scsi/scsi_tgt/Kconfig"
+
 config SCSI_SEAGATE
 	tristate "Seagate ST-02 and Future Domain TMC-8xx SCSI support"
 	depends on X86 && ISA && SCSI && BROKEN
```

## scst/kernel/in-tree/Kconfig.scsi_tgt
```kconfig
config SCSI_TARGET
	tristate "SCSI target middle level support"
	default SCSI
	depends on SCSI && PROC_FS
	---help---
	  SCSI TARGET is designed to provide unified, consistent interface
	  between SCSI target drivers and Linux kernel and simplify target
	  drivers development as much as possible.

config SCSI_TARGET_DISK
	tristate "SCSI target disk support"
	default SCSI_TARGET
	depends on SCSI && PROC_FS && SCSI_TARGET
	---help---
	  SCSI TARGET handler for disk device.

config SCSI_TARGET_TAPE
	tristate "SCSI target tape support"
	default SCSI_TARGET
	depends on SCSI && PROC_FS && SCSI_TARGET
	---help---
	  SCSI TARGET handler for tape device.

config SCSI_TARGET_CDROM
	tristate "SCSI target cdrom support"
	default SCSI_TARGET
	depends on SCSI && PROC_FS && SCSI_TARGET
	---help---
	  SCSI TARGET handler for cdrom device.

config SCSI_TARGET_MODISK
	tristate "SCSI target MO disk support"
	default SCSI_TARGET
	depends on SCSI && PROC_FS && SCSI_TARGET
	---help---
	  SCSI TARGET handler for MO disk device.

config SCSI_TARGET_CHANGER
	tristate "SCSI target changer support"
	default SCSI_TARGET
	depends on SCSI && PROC_FS && SCSI_TARGET
	---help---
	  SCSI TARGET handler for changer device.

config SCSI_TARGET_PROCESSOR
	tristate "SCSI target processor support"
	default SCSI_TARGET
	depends on SCSI && PROC_FS && SCSI_TARGET
	---help---
	  SCSI TARGET handler for processor device.

config SCSI_TARGET_RAID
	tristate "SCSI target storage array controller (raid) support"
	default SCSI_TARGET
	depends on SCSI && PROC_FS && SCSI_TARGET
	---help---
	  SCSI TARGET handler for raid storage array controller (raid) device.

config SCSI_TARGET_VDISK
	tristate "SCSI target virtual disk and/or cdrom support"
	default SCSI_TARGET
	depends on SCSI && PROC_FS && SCSI_TARGET
	---help---
	  SCSI TARGET handler for virtual disk and/or cdrom device.

config SCSI_TARGET_EXTRACHECKS
	bool "Extrachecks support"
	---help---
	  SCSI TARGET extrachecks.

config SCSI_TARGET_TRACING
	bool "Tracing support"
	---help---
	  SCSI TARGET tracing.

config SCSI_TARGET_DEBUG
	bool "Debug support"
	---help---
	  SCSI TARGET debugging.
```
